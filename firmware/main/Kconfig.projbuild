## firmware/main/Kconfig.projbuild
```kconfig
menu "Ai Watch"

    config AIW_WIFI_SSID
        string "WiFi SSID (e.g. phone hotspot name)"
        default "iPhone"
        help
            2.4 GHz Wi-Fi name to connect (e.g. iPhone personal hotspot).

    config AIW_WIFI_PASSWORD
        string "WiFi password"
        default "12345678"
        help
            Wi-Fi password.

    config AIW_MENUCONFIG_WIFI_FALLBACK
        bool "No NVS: try menuconfig WiFi before SoftAP (60s)"
        default n
        help
            If disabled (default): NVS 里没有保存过 wifi_ssid 时，不再尝试 menuconfig 里的 SSID，直接进入 AiWatch-xxxx 热点配网页（避免误连教程默认 iPhone 却无法访问公网）。
            If enabled: 先按 CONFIG_AIW_WIFI_* 连 STA 最多 60 秒，失败再开 SoftAP。

    config AIW_SERVER_BASE_URL
        string "Backend base URL (no trailing slash)"
        default "http://222.186.32.214:8765"
        help
            FastAPI 服务地址。配网网页可覆盖并写入 NVS（srv_url）。

    config AIW_PROV_AP_PASSWORD
        string "SoftAP password (provisioning mode)"
        default "12345678"
        help
            开发板开热点配网时，手机连 AiWatch-xxxx 使用的 WPA2 密码。

    config AIW_DEVICE_NAME
        string "Device display name"
        default "ai-watch-01"

endmenu
```

## firmware/sdkconfig.defaults
```kconfig
CONFIG_IDF_TARGET_ESP32S3=y
CONFIG_ESP32S3_SPIRAM_SUPPORT=y
CONFIG_SPIRAM=y
CONFIG_SPIRAM_MODE_OCT=y
CONFIG_SPIRAM_SPEED_80M=y
CONFIG_SPIRAM_BOOT_INIT=y
CONFIG_SPIRAM_USE_MALLOC=y
CONFIG_ESP_DEFAULT_CPU_FREQ_MHZ_240=y
CONFIG_ESP_WIFI_STATIC_RX_BUFFER_NUM=16
CONFIG_ESP_WIFI_DYNAMIC_RX_BUFFER_NUM=64
CONFIG_ESP_WIFI_DYNAMIC_TX_BUFFER_NUM=32
CONFIG_ESP_WIFI_AMPDU_TX_ENABLED=y
CONFIG_ESP_WIFI_AMPDU_RX_ENABLED=y
CONFIG_FREERTOS_HZ=1000

CONFIG_CODEC_ES8311_SUPPORT=y
```

## firmware_lvgl_board/main/Kconfig.projbuild
```kconfig
menu "Ai Watch"

    config AIW_WIFI_SSID
        string "WiFi SSID (e.g. phone hotspot name)"
        default "iPhone"
        help
            2.4 GHz Wi-Fi name to connect (e.g. iPhone personal hotspot).

    config AIW_WIFI_PASSWORD
        string "WiFi password"
        default "12345678"
        help
            Wi-Fi password.

    config AIW_MENUCONFIG_WIFI_FALLBACK
        bool "No NVS: try menuconfig WiFi before SoftAP (60s)"
        default n
        help
            If disabled (default): NVS 里没有保存过 wifi_ssid 时，不再尝试 menuconfig 里的 SSID，直接进入 AiWatch-xxxx 热点配网页（避免误连教程默认 iPhone 却无法访问公网）。
            If enabled: 先按 CONFIG_AIW_WIFI_* 连 STA 最多 60 秒，失败再开 SoftAP。

    config AIW_SERVER_BASE_URL
        string "Backend base URL (no trailing slash)"
        default "http://222.186.32.214:8765"
        help
            FastAPI 服务地址。配网网页可覆盖并写入 NVS（srv_url）。

    config AIW_PROV_AP_PASSWORD
        string "SoftAP password (provisioning mode)"
        default "12345678"
        help
            开发板开热点配网时，手机连 AiWatch-xxxx 使用的 WPA2 密码。

    config AIW_DEVICE_NAME
        string "Device display name"
        default "ai-watch-01"

    config AIW_SNTP_ENABLE
        bool "Enable SNTP (sync wall clock after Wi-Fi)"
        default y
        help
            Uses pool.ntp.org (or AIW_SNTP_SERVER) so the watch shows real local time.
            Set AIW_TZ to match your computer's timezone (POSIX TZ string).

    config AIW_SNTP_SERVER
        string "SNTP server hostname"
        default "cn.pool.ntp.org"
        depends on AIW_SNTP_ENABLE

    config AIW_TZ
        string "POSIX TZ (same idea as PC timezone)"
        default "CST-8"
        depends on AIW_SNTP_ENABLE
        help
            Examples: CST-8 (China mainland), UTC0, EST5EDT,M3.2.0/2,M11.1.0/2 (US Eastern with DST).

    config AIW_XL9555_SPK_HIGH_ENABLES_AMP
        bool "XL9555 MUTE/功放脚：高电平=喇叭通（无声时取消勾选试反相）"
        default y
        help
            与原理图中该脚接到 NS4150 类功放的 /SHDN、EN 还是 MUTE 有关。
            若开机滴声、播放仍无声，在《ESP32S3开发板原理图_V1.1》中查该脚有效电平，与本项相反时取消勾选。

endmenu
```

## firmware_lvgl_board/sdkconfig.defaults
```kconfig
# Ai Watch overlay: ES8311 (board audio)
CONFIG_CODEC_ES8311_SUPPORT=y

# Tutorial UI uses lv_font_montserrat_18 on the on-screen keyboard（图标符号亦用此字体）
CONFIG_LV_FONT_MONTSERRAT_18=y
CONFIG_LV_FONT_MONTSERRAT_14=y
# 语音对话页：环形进度（思考中）
CONFIG_LV_USE_ARC=y
CONFIG_LV_USE_SPINNER=y

# 屏上中文对话（DeepSeek 回复）；默认字体也用中文，避免方块字
CONFIG_LV_FONT_SIMSUN_16_CJK=y
# CONFIG_LV_FONT_DEFAULT_MONTSERRAT_14 is not set
CONFIG_LV_FONT_DEFAULT_SIMSUN_16_CJK=y

# 16MB Flash 布局（教程自带）；完整 LVGL + WiFi + Codec 超过默认 1MB 单应用分区
CONFIG_ESPTOOLPY_FLASHSIZE_16MB=y
CONFIG_ESPTOOLPY_FLASHSIZE="16MB"
CONFIG_PARTITION_TABLE_CUSTOM=y
CONFIG_PARTITION_TABLE_CUSTOM_FILENAME="partitions-16MiB.csv"

# 无 NVS 时不先连 menuconfig 里的 iPhone，直接开 SoftAP 浏览器配网（需要教程默认行为时在 menuconfig 勾选该项）
CONFIG_AIW_MENUCONFIG_WIFI_FALLBACK=n

# Phone hotspot / first boot fallback (menuconfig → Ai Watch)
CONFIG_AIW_WIFI_SSID="iPhone"
CONFIG_AIW_WIFI_PASSWORD="12345678"
CONFIG_AIW_SERVER_BASE_URL="http://222.186.32.214:8765"
CONFIG_AIW_PROV_AP_PASSWORD="12345678"

# 联网后 SNTP + HTTP(/api/time) 双路校时；默认中国 NTP 池 + 东八区
CONFIG_AIW_SNTP_ENABLE=y
CONFIG_AIW_SNTP_SERVER="cn.pool.ntp.org"
CONFIG_AIW_TZ="CST-8"

# 板载 NS4150 经 XL9555；若无声见 menuconfig → Ai Watch 反相项
CONFIG_AIW_XL9555_SPK_HIGH_ENABLES_AMP=y

# 商品规格 16MB Flash + 8MB OPI PSRAM（ESP32-S3-WROOM）；须在固件中启用，否则 malloc 仍只用内部 SRAM
CONFIG_ESP32S3_SPIRAM_SUPPORT=y
CONFIG_SPIRAM=y
CONFIG_SPIRAM_MODE_OCT=y
CONFIG_SPIRAM_SPEED_80M=y
CONFIG_SPIRAM_BOOT_INIT=y
CONFIG_SPIRAM_USE_MALLOC=y
```

## firmware_lvgl_scheme_a/main/Kconfig.projbuild
```kconfig
menu "Ai Watch"

    config AIW_WIFI_SSID
        string "WiFi SSID (e.g. phone hotspot name)"
        default "iPhone"
        help
            2.4 GHz Wi-Fi name to connect (e.g. iPhone personal hotspot).

    config AIW_WIFI_PASSWORD
        string "WiFi password"
        default "12345678"
        help
            Wi-Fi password.

    config AIW_SERVER_BASE_URL
        string "Backend base URL (no trailing slash)"
        default "http://172.20.10.4:8765"
        help
            Local FastAPI server URL.

    config AIW_DEVICE_NAME
        string "Device display name"
        default "ai-watch-01"

endmenu
```

## firmware_lvgl_scheme_a/sdkconfig.defaults.overlay
```kconfig
# Merged into generated firmware_lvgl_board/sdkconfig.defaults (keys appended if missing)
CONFIG_CODEC_ES8311_SUPPORT=y
CONFIG_LV_FONT_MONTSERRAT_18=y
CONFIG_ESPTOOLPY_FLASHSIZE_16MB=y
CONFIG_ESPTOOLPY_FLASHSIZE="16MB"
CONFIG_PARTITION_TABLE_CUSTOM=y
CONFIG_PARTITION_TABLE_CUSTOM_FILENAME="partitions-16MiB.csv"
# Default STA: iPhone personal hotspot (override in menuconfig if your SSID differs)
CONFIG_AIW_WIFI_SSID="iPhone"
CONFIG_AIW_WIFI_PASSWORD="12345678"
```
